## main/Kconfig.projbuild
```kconfig
menu "VIG Device Configuration"

    config VIGO_API_URL
        string "VIG API Base URL"
        default "http://vig_server.local/api"
        help
            The base URL for the VIG backend API.

    config VIGO_DEVICE_TOKEN
        string "VIG Device Token"
        default "default_token_change_me"
        help
            The authentication token for this device.

    config VIGO_HARDWARE_ID
        string "Hardware ID"
        default "ESP32P4_CAM_001"
        help
            Unique identifier for this hardware unit.

    config VIGO_HEARTBEAT_INTERVAL_MS
        int "Heartbeat Interval (ms)"
        default 30000
        range 1000 3600000
        help
            Time between heartbeat pulses in milliseconds.

    config VIGO_USE_MOCK_CAMERA
        bool "Use mock camera (for CI / no-hardware builds)"
        default n

    config VIGO_CAMERA_WIDTH
        int "Camera capture width"
        default 1280

    config VIGO_CAMERA_HEIGHT
        int "Camera capture height"
        default 960

    config VIGO_ENCODER_BITRATE_KBPS
        int "H.264 encoder bitrate (kbps)"
        default 2000

    config VIGO_ENCODER_GOP
        int "H.264 encoder GOP size"
        default 30

    config VIGO_STREAM_PORT
        int "Local stream server HTTP port"
        default 80

    config VIGO_STREAM_MAX_CLIENTS
        int "Max simultaneous WebSocket clients"
        default 4

    config VIGO_WIFI_SSID
        string "WiFi SSID"
        default ""
        help
            SSID of the WiFi network to connect to.

    config VIGO_WIFI_PASSWORD
        string "WiFi Password"
        default ""
        help
            Password for the WiFi network (WPA2-PSK).

    config VIGO_DTLS_CERT_PEM
        string "DTLS Certificate PEM"
        default "-----BEGIN CERTIFICATE-----\nMIIBfDCCASOgAwIBAgIUMPEdIVBibXtMlqg1DtWXqVYXsTkwCgYIKoZIzj0EAwIw\nFDESMBAGA1UEAwwJVmlnRGV2aWNlMB4XDTI2MDUyODA3MTM0NVoXDTM2MDUyNTA3\nMTM0NVowFDESMBAGA1UEAwwJVmlnRGV2aWNlMFkwEwYHKoZIzj0CAQYIKoZIzj0D\nAQcDQgAEpp90W5as0dtNXzjHTdxiu69xYUFrUouQWw9NWLOrtlUNyD2dUb9oEe1k\neHcnEOyzfECwqpcqWSA+MrLq1BpZNqNTMFEwHQYDVR0OBBYEFAIdRjWDVAfLt9gx\nd7Xaikf9ygGaMB8GA1UdIwQYMBaAFAIdRjWDVAfLt9gxd7Xaikf9ygGaMA8GA1Ud\nEwEB/wQFMAMBAf8wCgYIKoZIzj0EAwIDRwAwRAIgEVCUMZ4pQNGU51AuHAofPvrq\naKVO6EDge9s5XqG9pQYCIDFZnKKfJX8uZGJqv8GqG75RAD2/I5ecLYmPdDAASuQr\n-----END CERTIFICATE-----\n"
        help
            The PEM-formatted DTLS client certificate for WHIP WebRTC publisher.

    config VIGO_DTLS_KEY_PEM
        string "DTLS Private Key PEM"
        default "-----BEGIN EC PRIVATE KEY-----\nMHcCAQEEIOnub8RAPhTvHZk8lcfCc/6wHw2l848hKqTWbEbXPj1hoAoGCCqGSM49\nAwEHoUQDQgAEpp90W5as0dtNXzjHTdxiu69xYUFrUouQWw9NWLOrtlUNyD2dUb9o\nEe1keHcnEOyzfECwqpcqWSA+MrLq1BpZNg==\n-----END EC PRIVATE KEY-----\n"
        help
            The PEM-formatted DTLS client private key for WHIP WebRTC publisher.

    config VIGO_MOTION_STRIDE
        int "Motion detection stride"
        default 16
        help
            The stride for motion detection. Checks every Nth pixel in X and Y.

    config VIGO_MOTION_THRESHOLD
        int "Motion detection threshold"
        default 8
        range 0 255
        help
            The activation threshold of each pixel difference.

    config VIGO_MOTION_MIN_CHANGE_RATIO
        float "Motion detection minimum change ratio"
        default 0.015
        help
            The fraction of active points required to trigger motion.

    config VIGO_MOTION_COOLDOWN_MS
        int "Motion detection cooldown (ms)"
        default 10000
        help
            The minimum time between motion detection events.

    config VIGO_PEDESTRIAN_MAX_AREA_PROPORTION
        float "Max bounding box area proportion"
        default 0.70
        help
            The maximum fraction of the total image area a pedestrian bounding box can cover.
            Detections exceeding this threshold are discarded.

    config VIGO_PEDESTRIAN_MIN_ASPECT_RATIO
        float "Min bounding box aspect ratio (width/height)"
        default 0.10
        help
            The minimum aspect ratio (width / height) of a pedestrian bounding box.
            Set to 0.0 to disable aspect ratio minimum filtering.

    config VIGO_PEDESTRIAN_MAX_ASPECT_RATIO
        float "Max bounding box aspect ratio (width/height)"
        default 1.00
        help
            The maximum aspect ratio (width / height) of a pedestrian bounding box.
            Set to 0.0 to disable aspect ratio maximum filtering.

    config VIGO_PEDESTRIAN_CLASSIFICATION_THRESHOLD
        float "Pedestrian confidence threshold"
        default 0.75
        help
            The classification threshold for pedestrian detection (0.0 to 1.0).

endmenu
```
